## arch/arm64/Kconfig.xiaomi
```kconfig
# SPDX-License-Identifier: GPL-2.0-only

config BUILD_PRODUCT_NAME
	string "Product Name"
	help
	Product Name.
```

## drivers/dma-buf/heaps/Kconfig
```kconfig
menuconfig DMABUF_HEAPS_DEFERRED_FREE
	bool "DMA-BUF heaps deferred-free library"
	help
	  Choose this option to enable the DMA-BUF heaps deferred-free library.

menuconfig DMABUF_HEAPS_PAGE_POOL
	bool "DMA-BUF heaps page-pool library"
	help
	  Choose this option to enable the DMA-BUF heaps page-pool library.

config DMABUF_HEAPS_SYSTEM
	tristate "DMA-BUF System Heap"
	depends on DMABUF_HEAPS
	select DMABUF_HEAPS_PAGE_POOL
	help
	  Choose this option to enable the system dmabuf heap. The system heap
	  is backed by pages from the buddy allocator. If in doubt, say Y.

config DMABUF_HEAPS_CMA
	tristate "DMA-BUF CMA Heap"
	depends on DMABUF_HEAPS && DMA_CMA
	help
	  Choose this option to enable dma-buf CMA heap. This heap is backed
	  by the Contiguous Memory Allocator (CMA). If your system has these
	  regions, you should say Y here.

config DMABUF_HEAPS_SYSTEM
        tristate "DMA-BUF System Heap"
        depends on DMABUF_HEAPS
        help
          Choose this option to enable the system dmabuf heap. The system heap
          is backed by pages from the buddy allocator. If in doubt, say Y.

config DMABUF_HEAPS_REFILL
        tristate "DMA-BUF heap refill"
        depends on DMABUF_HEAPS_SYSTEM
        help
          Choose this option to enable heap refill. Pool has high water and low
          water. After executing dmabuf alloc and detecting that the current pool
          size is lower than the low water, the refill thread is started. The
          refill worker thread allocates pages to fill in the pool, and stops
          filling when the pool size is higher than the high water mark.

config DMABUF_HEAPS_DEBUG
        tristate "DMA-BUF debug Heap"
        depends on DMABUF_HEAPS_SYSTEM
        help
          Choose this option to enable the mtk debug heap.
          This debug tool can be use to dump dmabuf usage for users
          If you want use it, say Y if you are not using GKI
          say m and add ko into your system for GKI.
```

## drivers/media/platform/mediatek/jpeg/Kconfig
```kconfig
# SPDX-License-Identifier: GPL-2.0-only
config DEVICE_MODULES_VIDEO_MEDIATEK_JPEG
	tristate "Mediatek JPEG Codec driver"
	depends on MTK_IOMMU_V1 || DEVICE_MODULES_MTK_IOMMU || COMPILE_TEST
	depends on VIDEO_DEV
	depends on ARCH_MEDIATEK || COMPILE_TEST
	depends on DEVICE_MODULES_MTK_SMI || (COMPILE_TEST && DEVICE_MODULES_MTK_SMI=n)
	select VIDEOBUF2_DMA_CONTIG
	select V4L2_MEM2MEM_DEV
	help
	  Mediatek jpeg codec driver provides HW capability to decode
	  JPEG format

	  To compile this driver as a module, choose M here: the
	  module will be called mtk-jpeg
```

## drivers/media/platform/mediatek/vcodec/Kconfig
```kconfig
# SPDX-License-Identifier: GPL-2.0-only
config VIDEO_MEDIATEK_VCODEC_SCP
	bool

config VIDEO_MEDIATEK_VCODEC_VPU
	bool

config DEVICE_MODULES_VIDEO_MEDIATEK_VCODEC
	tristate "Mediatek Video Codec driver"
	depends on DEVICE_MODULES_MTK_IOMMU || COMPILE_TEST
	depends on VIDEO_DEV
	depends on ARCH_MEDIATEK || COMPILE_TEST
	depends on VIDEO_MEDIATEK_VPU || MTK_SCP || MTK_TINYSYS_VCP_SUPPORT || VIDEO_MEDIATEK_VCU
	# The two following lines ensure we have the same state ("m" or "y") as
	# our dependencies, to avoid missing symbols during link.
	depends on VIDEO_MEDIATEK_VPU || !VIDEO_MEDIATEK_VPU
	depends on MTK_SCP || !MTK_SCP
	depends on MTK_TINYSYS_VCP_SUPPORT || !MTK_TINYSYS_VCP_SUPPORT
	depends on DEVICE_MODULES_MTK_SMI || (COMPILE_TEST && DEVICE_MODULES_MTK_SMI=n)
	select VIDEOBUF2_DMA_CONTIG
	select V4L2_MEM2MEM_DEV
	select VB2_MEDIATEK_DMA_CONTIG
	help
	  Mediatek video codec driver provides HW capability to
	  encode and decode in a range of video formats on MT8173
	  and MT8183.

	  Note that support for MT8173 requires VIDEO_MEDIATEK_VPU to
	  also be selected. Support for MT8183 depends on MTK_SCP.

	  To compile this driver as modules, choose M here: the
	  modules will be called mtk-vcodec-dec and mtk-vcodec-enc.

config MTK_TINYSYS_VCP_SUPPORT
	tristate "Mediatek VCP driver"
	help
	  Mediatek video kernel driver for micro-P.

	  The driver support control and communicate vcp and allocate,
	  free memory, etc.

	  To compile this driver as modules, choose M here: the
	  modules will be called vcp and vcp_status.

config VIDEO_MEDIATEK_VCODEC_V1
	bool "Specify Mediatek Video Vcodec Platform V1"
	depends on MTK_LOW_POWER_MODULE
	help
	  Select MediaTek Video Vcodec Platform V1
	  v1 folder is dvfs setting for policy 1
	  Set Y to select this feature for specific platform-V1.
	  If unsure, set N to disable.

config VIDEO_MEDIATEK_VCODEC_V2
	bool "Specify Mediatek Video Vcodec Platform V2"
	depends on MTK_LOW_POWER_MODULE
	help
	  Select MediaTek Video Vcodec Platform V2
	  v2 folder is dvfs setting for policy 2
	  Set Y to select this feature for specific platform-V2.
	  If unsure, set N to disable.
```

## drivers/media/platform/mediatek/vcu/Kconfig
```kconfig
config VIDEO_MEDIATEK_VCU
	tristate "Mediatek VCU driver"
	help
	  Mediatek video kernel driver for user space vpud.

	  The driver support communicate with user space video driver vpud
	  and allocate, free memory, etc.

	  To compile this driver as modules, choose M here: the
	  modules will be called mtk-vcu.
```

## drivers/misc/mediatek/usb/Kconfig
```kconfig
# SPDX-License-Identifier: GPL-2.0

source "drivers/misc/mediatek/usb/usb_rndis/Kconfig"
source "drivers/misc/mediatek/usb/usb_xhci/Kconfig"
```
